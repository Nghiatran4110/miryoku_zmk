// Copyright 2021 Manna Harbour
// https://github.com/manna-harbour/miryoku

#include "../miryoku/custom_config.h"
#include "../miryoku/mapping/42/corne.h"
#include "../miryoku/miryoku.dtsi"
/ {
    combos {
        compatible = "zmk,combos";

        combo_studio_unlock {
            timeout-ms = <50>;
            key-positions = <0 11>;
            bindings = <&studio_unlock>;
        };
    };
};
